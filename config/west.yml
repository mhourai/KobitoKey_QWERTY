## config/west.yml
```yaml
manifest:
  remotes:
    - name: cormoran   # <-- dya-studio (ZMKフォーク本体 + 専用モジュール)
      url-base: https://github.com/cormoran
    - name: badjeff
      url-base: https://github.com/badjeff
    - name: hsgw
      url-base: https://github.com/hsgw
    - name: caksoylar  # <-- led
      url-base: https://github.com/caksoylar

  projects:
    # ZMK 本体を cormoran フォークに差し替え（dya-studio のカスタムStudioプロトコル対応版）
    - name: zmk
      remote: cormoran
      revision: v0.3-branch+dya
      import: app/west.yml

    # Zephyr も cormoran のカスタム版に差し替え（上記 zmk フォークが要求）
    - name: zephyr
      remote: cormoran
      revision: v3.5.0+zmk-fixes+nrf-half-duplex-uart
      clone-depth: 1
      import:
        name-blocklist:
          - ci-tools
          - hal_altera
          - hal_cypress
          - hal_infineon
          - hal_microchip
          - hal_nxp
          - hal_openisa
          - hal_silabs
          - hal_xtensa
          - hal_st
          - hal_ti
          - loramac-node
          - mcuboot
          - mcumgr
          - net-tools
          - openthread
          - edtt
          - trusted-firmware-m

    # dya-studio 設定RPC（キーマップ/設定を Studio 経由で読み書き）
    - name: zmk-module-settings-rpc
      remote: cormoran
      revision: main

    # PMW3610 ドライバ（既存: badjeff）
    - name: zmk-pmw3610-driver
      remote: badjeff
      revision: zmk-0.3

    # Sensor-rotation（既存: hsgw）
    - name: zmk-feature-sensor_rotation
      remote: hsgw
      revision: main

    # LED（既存: caksoylar）
    - name: zmk-rgbled-widget
      remote: caksoylar
      revision: v0.3

  self:
    path: config
```
